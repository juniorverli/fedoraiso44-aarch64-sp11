// SPDX-License-Identifier: BSD-3-Clause
/*
 * M14 fallback (automatic entry): exactly the M13 `m13` content. M12 board DT (touch on, GPU off,
 * D20 parity) plus the sound card with the digital microphones only. GPU off, no camera node
 * enabled, speakers off (S1). Requires audio-speakers patch 0003 (x1-microsoft-denali-audio-mics.dtsi).
 * Built by the kernel DTB variants script; not a patch, not part of the RPM.
 */
#include "x1p64100-microsoft-denali-m12.dts"
#include "x1-microsoft-denali-audio-mics.dtsi"
