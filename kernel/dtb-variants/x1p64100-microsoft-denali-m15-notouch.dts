// SPDX-License-Identifier: BSD-3-Clause
/* M15 fallback: the M15 microphone fallback (m15-safe) with only the touch child disabled. */
#include "x1p64100-microsoft-denali-m15-safe.dts"

&{/soc@0/geniqup@ac0000/spi@a88000/touchscreen@0} {
	status = "disabled";
};
