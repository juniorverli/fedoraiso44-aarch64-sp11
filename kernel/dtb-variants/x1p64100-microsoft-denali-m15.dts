// SPDX-License-Identifier: BSD-3-Clause
/*
 * M15 combined diagnostic default: everything under test in one boot. Includes m15-safe
 * (microphones, speakers with D26 open-loop protection, DisplayPort audio, touch, cameras)
 * plus the Adreno GPU enabled (as m13-gpu: &gpu with GMU and zap).
 * The IR emitter and flash stay undescribed (S2).
 * Built by the kernel DTB variants script; not a patch, not part of the RPM.
 */
#include "x1p64100-microsoft-denali-m15-safe.dts"

/*
 * Rev25 reset isolation: the m15 debug variant previously carried the unproven usb-typec 0003 experiment that
 * deletes `orientation-switch` from both QMP combo PHYs. Every debug GRUB variant reset (including msm-off,
 * pinoff, ACD-off, preemption-off and multi-user), while every m15-safe boot survived; the m15-vs-m15-safe DTB
 * diff is the GPU node plus this deletion. Keep the safe orientation-switch behaviour in m15 and test the GPU
 * difference independently. The USB-C double-flip experiment is not promoted; see the rev25 evidence.
 */
&gpu {
	status = "okay";
};
