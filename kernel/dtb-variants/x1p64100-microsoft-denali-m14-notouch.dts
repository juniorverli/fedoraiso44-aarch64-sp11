// SPDX-License-Identifier: BSD-3-Clause
/* M14 fallback: the M14 microphone fallback (m14-safe) with only the touch child disabled. */
#include "x1p64100-microsoft-denali-m14-safe.dts"

&{/soc@0/geniqup@ac0000/spi@a88000/touchscreen@0} {
	status = "disabled";
};
