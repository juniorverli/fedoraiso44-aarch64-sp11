// SPDX-License-Identifier: BSD-3-Clause
/*
 * M11 audio variant (stage A): the M10 board DT (touch on, GPU off, D20 parity) plus the
 * sound card with the digital microphones only. Speakers stay off (S1): the WSA playback
 * link is removed from the card and &swr0 stays disabled, so no WSA8845 is enumerated.
 * Requires audio-speakers patch 0003 (x1-microsoft-denali-audio-mics.dtsi).
 * Built by scripts/kernel-dtb-variants.sh; not a patch, not part of the RPM.
 */
#include "x1p64100-microsoft-denali-m10.dts"
#include "x1-microsoft-denali-audio-mics.dtsi"
