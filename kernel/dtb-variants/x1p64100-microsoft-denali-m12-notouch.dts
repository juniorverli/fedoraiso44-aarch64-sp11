// SPDX-License-Identifier: BSD-3-Clause
/* M12 fallback: disable only the touch child. */
#include "x1p64100-microsoft-denali-m12.dts"

&{/soc@0/geniqup@ac0000/spi@a88000/touchscreen@0} {
	status = "disabled";
};
